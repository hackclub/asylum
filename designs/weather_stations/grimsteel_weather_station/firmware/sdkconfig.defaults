## designs/weather_stations/grimsteel_weather_station/firmware/sdkconfig.defaults
```kconfig
# CONFIG_ESP_WIFI_ENABLE_WPA3_SAE is not set
# CONFIG_ESP_WIFI_SOFTAP_SUPPORT is not set
CONFIG_LV_THEME_DEFAULT_DARK=y
CONFIG_LV_FS_DEFAULT_DRIVE_LETTER=65
CONFIG_LV_USE_FS_STDIO=y
CONFIG_LV_FS_STDIO_LETTER=65
CONFIG_LV_USE_ST7735=y
# CONFIG_LV_USE_GENERIC_MIPI is not set
# CONFIG_LV_BUILD_EXAMPLES is not set
```
